## security/my_test/Kconfig
```kconfig
# SPDX-License-Identifier: GPL-2.0-only
config SECURITY_MY_TEST
        bool "My Test LSM"
        depends on SECURITY
        select SECURITYFS
        default y
        help
          My Test LSM
```
